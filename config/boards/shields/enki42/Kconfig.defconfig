## config/boards/shields/enki42/Kconfig.defconfig
```kconfig
# Copyright (c) 2020 The ZMK Contributors
# SPDX-License-Identifier: MIT

if SHIELD_ENKI42_DONGLE

config ZMK_KEYBOARD_NAME
	default "enki42 Dongle"
	
config ZMK_SPLIT_BLE_ROLE_CENTRAL
	default y
	
config ZMK_USB
	default y

endif

if SHIELD_ENKI42_LEFT || SHIELD_ENKI42_RIGHT || SHIELD_ENKI42_DONGLE 

config ZMK_SPLIT
	default y

config ZMK_BLE
	default y
	
endif
```

## config/boards/shields/enki42/Kconfig.shield
```kconfig
# Copyright (c) 2020 The ZMK Contributors
# SPDX-License-Identifier: MIT

config SHIELD_ENKI42_LEFT
	def_bool $(shields_list_contains,enki42_left)

config SHIELD_ENKI42_RIGHT
	def_bool $(shields_list_contains,enki42_right)

config SHIELD_ENKI42_DONGLE
	def_bool $(shields_list_contains,enki42_dongle)
```

## config/west.yml
```yaml
manifest:
  remotes:    
    - name: aroum
      url-base: https://github.com/aroum
  projects:
    - name: zmk
      remote: aroum
      revision: main
      import: app/west.yml
  self:
    path: config
```
